/*
 * Copyright (c) 2020 The ZMK Contributors
 *
 * SPDX-License-Identifier: MIT
 */

#include "piano.dtsi"

&default_transform {
	col-offset = <9>;
};

/* &pwm0 { */
/*     status = "okay"; */
/*     ch0-pin = <15>; */
/* }; */
